#include <PCM.h>
void wait();
void game();
const unsigned char sample[] PROGMEM = {126, 126, 128, 128, 129, 129, 128, 128, 127, 127, 128, 128, 128,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 171, 
};

const int buttonPin = 2;
int buttonState=0;
void setup()
{
  pinMode(buttonPin, INPUT);
}

void loop()
{
  game();
}

void game(){
  while(1){
    startPlayback(sample, sizeof(sample));    
    delay(6000);
    buttonState = digitalRead(buttonPin);
    if (buttonState == HIGH){
      while(buttonState == HIGH){buttonState=digitalRead(buttonPin);}
      wait();
    }
  }
}

void wait(){
  buttonState = LOW;
  while(buttonState == LOW){
    //TODO: "Are you sure" Message here
    buttonState = digitalRead(buttonPin);
    if(buttonState == HIGH){
      delay(1000);
      return;
    }
  }
}
